## targets/ipq95xx/image/Config.in
```kconfig
config TARGET_BUILD_PRPL
	bool "Target Build - PRPL"
	depends on TARGET_ipq95xx
	default n

config TARGET_ENABLE_SINGLE_IMAGE
	bool "Enable Single Image Generation"
	depends on TARGET_ipq95xx
	default n
```
